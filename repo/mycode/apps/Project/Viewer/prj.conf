## prj.conf
```kconfig
CONFIG_GPIO=y
CONFIG_ENTROPY_GENERATOR=y
#CONFIG_UART_INTERRUPT_DRIVEN=y
CONFIG_SERIAL=y

CONFIG_SHELL=y
CONFIG_SHELL_BACKEND_SERIAL=y
CONFIG_UART_CONSOLE=y


CONFIG_CBPRINTF_COMPLETE=y
CONFIG_LOG=y
CONFIG_LOG_DEFAULT_LEVEL=3
CONFIG_LOG_MODE_DEFERRED=y
CONFIG_RTC=y

CONFIG_I2C=y



CONFIG_SPI=y
CONFIG_FLASH_MAP=y
CONFIG_NVS=y
CONFIG_FS_LOG_LEVEL_DBG=y
CONFIG_ESP32_USE_UNSUPPORTED_REVISION=y
CONFIG_MAIN_STACK_SIZE=4096

CONFIG_SHELL_BACKEND_SERIAL=y


#For bluetooth 

CONFIG_BT=y
CONFIG_BT_BROADCASTER=y
CONFIG_BT_OBSERVER=y
CONFIG_BT_DEVICE_NAME="M5_Ben"


#display
# Enable LVGL
CONFIG_LVGL=y
#CONFIG_LV_COLOR_DEPTH=16
CONFIG_LV_Z_MEM_POOL_SIZE=16384

# Enable LVGL features
CONFIG_LV_USE_LOG=y
CONFIG_LV_USE_LABEL=y
CONFIG_LV_USE_ARC=y
CONFIG_LV_FONT_MONTSERRAT_14=y

# Enable display subsystem
CONFIG_DISPLAY=y
CONFIG_DISPLAY_LOG_LEVEL_ERR=y

# Enable GPIO and SPI for the display
CONFIG_GPIO=y
CONFIG_SPI=y




#CONFIG_MAIN_STACK_SIZE=4096 #for file system
```

## boards/m5stack_core2_procpu.overlay
```dts
/ {
    chosen {
        zephyr,display = &ili9342c; // Reference the ili9342c label
    };
};

&ili9342c {
    compatible = "ilitek,ili9342c";
    mipi-max-frequency = <30000000>;
    reg = <0>;
    vin-supply = <&lcd_bg>;
    pixel-format = <ILI9XXX_PIXEL_FORMAT_RGB565>;
    display-inversion;
    width = <320>;
    height = <240>;
    rotation = <0>;
    status = "okay"; // Ensure the node is enabled
};
```

## src/main.c
```c
#include <stdio.h>
#include "ble.c"
#include "display.h"

#include <zephyr/kernel.h>
#include <zephyr/drivers/gpio.h>
#include <zephyr/random/random.h>
#include <zephyr/shell/shell.h>
#include <zephyr/logging/log.h>
#include <inttypes.h>
#include <zephyr/drivers/pwm.h>
#include <zephyr/devicetree.h>


#include <zephyr/bluetooth/bluetooth.h>
#include <zephyr/bluetooth/conn.h>
#include <zephyr/bluetooth/gatt.h>
#include <zephyr/bluetooth/uuid.h>
#include <zephyr/bluetooth/hci.h>



#define SLEEP_TIME_MS   1000
#define STACK_SIZE 4096
#define BLE_PRIORITY 7
#define BLE_PRIORITY 7
#define MSGQ_SIZE 10
#define MSGQ_ALIGNMENT 4

K_THREAD_DEFINE(BLE, STACK_SIZE, scan_thread, NULL, NULL, NULL, BLE_PRIORITY,0,0);
K_THREAD_DEFINE(DIS, STACK_SIZE, display_thread, NULL, NULL, NULL, BLE_PRIORITY,0,0);


/*
int main(){
    uint8_t value = 0;
    init_display();

    printf("started\n");
    while(1){
        //place_red_dot(1,2);
        lv_timer_handler();
        //printf("running");
        //printf("Sending value: %d\n", value);
        //restart_advertising(value++);
        k_msleep(5);
        //printf("Advertising restarted with value: %d\n", value);
    }
    return 0;
}*/
```

## src/ble.h
```c
#ifndef BLE_H
#define BLE_H

#include <zephyr/kernel.h>
#include <zephyr/device.h>
#include <zephyr/drivers/rtc.h>
#include <zephyr/sys/util.h>
#include <zephyr/devicetree.h>
#include <zephyr/shell/shell.h>

void scan_thread(void);



#endif 
```

## src/display.h
```c
#ifndef DISPLAY_H
#define DISPLAY_H

#include <zephyr/kernel.h>
#include <zephyr/device.h>
#include <zephyr/drivers/rtc.h>
#include <zephyr/sys/util.h>
#include <zephyr/devicetree.h>
#include <zephyr/shell/shell.h>


void init_display(void);
void place_red_dot(float x, float y);
void display_thread(void);
#endif 
```

## repo/mycode/apps/prac2/task1/src/build/Kconfig/soc/Kconfig
```kconfig
# Load Zephyr SoC Kconfig descriptions.
osource "/home/s4803486/csse4011/repo/zephyr/soc/xlnx/zynqmp/Kconfig"
osource "/home/s4803486/csse4011/repo/zephyr/soc/xlnx/zynq7000/Kconfig"
osource "/home/s4803486/csse4011/repo/zephyr/soc/xen/Kconfig"
osource "/home/s4803486/csse4011/repo/zephyr/soc/wch/ch32v/Kconfig"
osource "/home/s4803486/csse4011/repo/zephyr/soc/ti/simplelink/Kconfig"
osource "/home/s4803486/csse4011/repo/zephyr/soc/ti/lm3s6965/Kconfig"
osource "/home/s4803486/csse4011/repo/zephyr/soc/ti/k3/Kconfig"
osource "/home/s4803486/csse4011/repo/zephyr/soc/telink/tlsr/Kconfig"
osource "/home/s4803486/csse4011/repo/zephyr/soc/starfive/jh71xx/Kconfig"
osource "/home/s4803486/csse4011/repo/zephyr/soc/st/stm32/Kconfig"
osource "/home/s4803486/csse4011/repo/zephyr/soc/snps/qemu_arc/Kconfig"
osource "/home/s4803486/csse4011/repo/zephyr/soc/snps/nsim/arc_v/Kconfig"
osource "/home/s4803486/csse4011/repo/zephyr/soc/snps/nsim/arc_classic/Kconfig"
osource "/home/s4803486/csse4011/repo/zephyr/soc/snps/hsdk4xd/Kconfig"
osource "/home/s4803486/csse4011/repo/zephyr/soc/snps/hsdk/Kconfig"
osource "/home/s4803486/csse4011/repo/zephyr/soc/snps/emsk/Kconfig"
osource "/home/s4803486/csse4011/repo/zephyr/soc/snps/emsdp/Kconfig"
osource "/home/s4803486/csse4011/repo/zephyr/soc/snps/arc_iot/Kconfig"
osource "/home/s4803486/csse4011/repo/zephyr/soc/silabs/Kconfig"
osource "/home/s4803486/csse4011/repo/zephyr/soc/sifive/sifive_freedom/Kconfig"
osource "/home/s4803486/csse4011/repo/zephyr/soc/sensry/Kconfig"
osource "/home/s4803486/csse4011/repo/zephyr/soc/rockchip/Kconfig"
osource "/home/s4803486/csse4011/repo/zephyr/soc/renode/riscv_virtual/Kconfig"
osource "/home/s4803486/csse4011/repo/zephyr/soc/renode/cortex_r8_virtual/Kconfig"
osource "/home/s4803486/csse4011/repo/zephyr/soc/renesas/smartbond/Kconfig"
osource "/home/s4803486/csse4011/repo/zephyr/soc/renesas/rzt2m/Kconfig"
osource "/home/s4803486/csse4011/repo/zephyr/soc/renesas/rz/Kconfig"
osource "/home/s4803486/csse4011/repo/zephyr/soc/renesas/rcar/Kconfig"
osource "/home/s4803486/csse4011/repo/zephyr/soc/renesas/ra/Kconfig"
osource "/home/s4803486/csse4011/repo/zephyr/soc/realtek/ec/Kconfig"
osource "/home/s4803486/csse4011/repo/zephyr/soc/raspberrypi/rpi_pico/Kconfig"
osource "/home/s4803486/csse4011/repo/zephyr/soc/quicklogic/eos_s3/Kconfig"
osource "/home/s4803486/csse4011/repo/zephyr/soc/qemu/virt_riscv/Kconfig"
osource "/home/s4803486/csse4011/repo/zephyr/soc/qemu/malta/Kconfig"
osource "/home/s4803486/csse4011/repo/zephyr/soc/openisa/rv32m1/Kconfig"
osource "/home/s4803486/csse4011/repo/zephyr/soc/nxp/s32/Kconfig"
osource "/home/s4803486/csse4011/repo/zephyr/soc/nxp/rw/Kconfig"
osource "/home/s4803486/csse4011/repo/zephyr/soc/nxp/mcx/Kconfig"
osource "/home/s4803486/csse4011/repo/zephyr/soc/nxp/lpc/Kconfig"
osource "/home/s4803486/csse4011/repo/zephyr/soc/nxp/layerscape/Kconfig"
osource "/home/s4803486/csse4011/repo/zephyr/soc/nxp/kinetis/Kconfig"
osource "/home/s4803486/csse4011/repo/zephyr/soc/nxp/imxrt/Kconfig"
osource "/home/s4803486/csse4011/repo/zephyr/soc/nxp/imx/Kconfig"
osource "/home/s4803486/csse4011/repo/zephyr/soc/nuvoton/numicro/Kconfig"
osource "/home/s4803486/csse4011/repo/zephyr/soc/nuvoton/numaker/Kconfig"
osource "/home/s4803486/csse4011/repo/zephyr/soc/nuvoton/npcx/Kconfig"
osource "/home/s4803486/csse4011/repo/zephyr/soc/nuvoton/npcm/Kconfig"
osource "/home/s4803486/csse4011/repo/zephyr/soc/nordic/Kconfig"
osource "/home/s4803486/csse4011/repo/zephyr/soc/neorv32/Kconfig"
osource "/home/s4803486/csse4011/repo/zephyr/soc/native/inf_clock/Kconfig"
osource "/home/s4803486/csse4011/repo/zephyr/soc/microchip/miv/Kconfig"
osource "/home/s4803486/csse4011/repo/zephyr/soc/microchip/mec/Kconfig"
osource "/home/s4803486/csse4011/repo/zephyr/soc/mediatek/mt8xxx/Kconfig"
osource "/home/s4803486/csse4011/repo/zephyr/soc/lowrisc/opentitan/Kconfig"
osource "/home/s4803486/csse4011/repo/zephyr/soc/litex/litex_vexriscv/Kconfig"
osource "/home/s4803486/csse4011/repo/zephyr/soc/ite/ec/Kconfig"
osource "/home/s4803486/csse4011/repo/zephyr/soc/intel/raptor_lake/Kconfig"
osource "/home/s4803486/csse4011/repo/zephyr/soc/intel/lakemont/Kconfig"
osource "/home/s4803486/csse4011/repo/zephyr/soc/intel/intel_socfpga_std/Kconfig"
osource "/home/s4803486/csse4011/repo/zephyr/soc/intel/intel_socfpga/Kconfig"
osource "/home/s4803486/csse4011/repo/zephyr/soc/intel/intel_niosv/Kconfig"
osource "/home/s4803486/csse4011/repo/zephyr/soc/intel/intel_ish/Kconfig"
osource "/home/s4803486/csse4011/repo/zephyr/soc/intel/intel_adsp/Kconfig"
osource "/home/s4803486/csse4011/repo/zephyr/soc/intel/elkhart_lake/Kconfig"
osource "/home/s4803486/csse4011/repo/zephyr/soc/intel/atom/Kconfig"
osource "/home/s4803486/csse4011/repo/zephyr/soc/intel/apollo_lake/Kconfig"
osource "/home/s4803486/csse4011/repo/zephyr/soc/intel/alder_lake/Kconfig"
osource "/home/s4803486/csse4011/repo/zephyr/soc/infineon/cat3/Kconfig"
osource "/home/s4803486/csse4011/repo/zephyr/soc/infineon/cat1b/Kconfig"
osource "/home/s4803486/csse4011/repo/zephyr/soc/infineon/cat1a/Kconfig"
osource "/home/s4803486/csse4011/repo/zephyr/soc/gd/gd32/Kconfig"
osource "/home/s4803486/csse4011/repo/zephyr/soc/gaisler/leon3/Kconfig"
osource "/home/s4803486/csse4011/repo/zephyr/soc/gaisler/gr716a/Kconfig"
osource "/home/s4803486/csse4011/repo/zephyr/soc/espressif/Kconfig"
osource "/home/s4803486/csse4011/repo/zephyr/soc/ene/kb1200/Kconfig"
osource "/home/s4803486/csse4011/repo/zephyr/soc/efinix/sapphire/Kconfig"
osource "/home/s4803486/csse4011/repo/zephyr/soc/cdns/xtensa_sample_controller/Kconfig"
osource "/home/s4803486/csse4011/repo/zephyr/soc/cdns/sample_controller32/Kconfig"
osource "/home/s4803486/csse4011/repo/zephyr/soc/cdns/dc233c/Kconfig"
osource "/home/s4803486/csse4011/repo/zephyr/soc/brcm/bcmvk/Kconfig"
osource "/home/s4803486/csse4011/repo/zephyr/soc/brcm/bcm2712/Kconfig"
osource "/home/s4803486/csse4011/repo/zephyr/soc/brcm/bcm2711/Kconfig"
osource "/home/s4803486/csse4011/repo/zephyr/soc/atmel/sam0/Kconfig"
osource "/home/s4803486/csse4011/repo/zephyr/soc/atmel/sam/Kconfig"
osource "/home/s4803486/csse4011/repo/zephyr/soc/aspeed/Kconfig"
osource "/home/s4803486/csse4011/repo/zephyr/soc/arm/Kconfig"
osource "/home/s4803486/csse4011/repo/zephyr/soc/arm/beetle/Kconfig"
osource "/home/s4803486/csse4011/repo/zephyr/soc/antmicro/myra/Kconfig"
osource "/home/s4803486/csse4011/repo/zephyr/soc/andestech/Kconfig"
osource "/home/s4803486/csse4011/repo/zephyr/soc/amd/acp_6_0/Kconfig"
osource "/home/s4803486/csse4011/repo/zephyr/soc/ambiq/Kconfig"
osource "/home/s4803486/csse4011/repo/zephyr/soc/altr/zephyr_nios2f/Kconfig"
osource "/home/s4803486/csse4011/repo/zephyr/soc/altr/qemu_nios2/Kconfig"
osource "/home/s4803486/csse4011/repo/zephyr/soc/adi/max32/Kconfig"
```

## repo/mycode/apps/s1/task1/src/build/Kconfig/boards/Kconfig.defconfig
```kconfig
# Load Zephyr board defconfig descriptions.
osource "/home/s4803486/csse4011/repo/zephyr/boards/st/disco_l475_iot1/Kconfig.defconfig"
```

## repo/mycode/apps/s1/task2/src/build/Kconfig/boards/Kconfig
```kconfig
# Load Zephyr board Kconfig descriptions.
osource "/home/s4803486/csse4011/repo/zephyr/boards/st/disco_l475_iot1/Kconfig"
```

## repo/mycode/apps/s1/task3/src/build/Kconfig/arch/Kconfig
```kconfig
# Load Zephyr Arch Kconfig descriptions.
osource "/home/s4803486/csse4011/repo/zephyr/arch/x86/Kconfig"
osource "/home/s4803486/csse4011/repo/zephyr/arch/xtensa/Kconfig"
osource "/home/s4803486/csse4011/repo/zephyr/arch/sparc/Kconfig"
osource "/home/s4803486/csse4011/repo/zephyr/arch/riscv/Kconfig"
osource "/home/s4803486/csse4011/repo/zephyr/arch/posix/Kconfig"
osource "/home/s4803486/csse4011/repo/zephyr/arch/nios2/Kconfig"
osource "/home/s4803486/csse4011/repo/zephyr/arch/mips/Kconfig"
osource "/home/s4803486/csse4011/repo/zephyr/arch/arm64/Kconfig"
osource "/home/s4803486/csse4011/repo/zephyr/arch/arm/Kconfig"
osource "/home/s4803486/csse4011/repo/zephyr/arch/arc/Kconfig"
```
